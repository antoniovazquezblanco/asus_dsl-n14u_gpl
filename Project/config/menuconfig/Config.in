## Project/config/menuconfig/Config.in
```kconfig
#
# TC Linux configuration
#

choice
	prompt "CPU Type"
	
config TCSUPPORT_CPU_RT63365
	bool "TCSUPPORT_CPU_RT63365 Support"
	select WAN_ATM
	select WAN_ETHER
	help
	      CPU RT63365 support
config TCSUPPORT_CPU_RT63368
	bool "TCSUPPORT_CPU_RT63368 Support"
	select WAN_ATM
	select WAN_ETHER
	help
	      CPU RT63368 support

config TCSUPPORT_CPU_RT65168
	bool "TCSUPPORT_CPU_RT65168 Support"
	select WAN_ATM
	select WAN_PTM
	select WAN_ETHER
	help
	      CPU RT65168 support
endchoice

config WAN_ATM
	bool

config WAN_PTM
	bool

config WAN_ETHER
	bool

if WAN_ATM || WAN_PTM || WAN_ETHER

menu "WAN Transfer Mode Support"

comment "At Least One of The Following Has to Be Chosen!"

config TCSUPPORT_WAN_ATM
	depends on WAN_ATM
	bool "Support ATM WAN Transfer Mode"
	help
		  Support ATM WAN Transfer Mode

config TCSUPPORT_WAN_PTM
	depends on WAN_PTM
	bool "Support PTM WAN Transfer Mode"
	help
		  Support PTM WAN Transfer Mode

config TCSUPPORT_WAN_ETHER
	depends on WAN_ETHER
	bool "Support Ethernet WAN Transfer Mode"
	help
		  Support Ethernet WAN Transfer Mode
endmenu
endif

choice
	prompt "Bootbase Suppport SDRAMSIZE"
	
config TCSUPPORT_SDRAM_32M
	bool "Support 32M SDRAM"
	help
	      Support 32M SDRAM	      		

config TCSUPPORT_SDRAM_64M
	bool "Support 64M SDRAM"
	help
	      Support 64M SDRAM
		 
endchoice


config TCSUPPORT_BOOT_LZMA
	bool "Bootloader Compression Support"
	help
		  Support bootloader compression

choice
	prompt "Bootbase Suppport Flash"
	depends (TCSUPPORT_CPU_RT63365 || TCSUPPORT_CPU_RT63368) 

config TCSUPPORT_BB_SPI
	bool "TCSUPPORT_BB_SPI Support"
	help
			Bootbase Spi flash support

config TCSUPPORT_BB_NAND
	bool "TCSUPPORT_BB_NAND Support"
	help
			Bootbase Nand flash support

endchoice




#No support Purebridge Mode
#config TCSUPPORT_PUREBRIDGE
#	depends TCSUPPORT_CPU_TC3162
#	bool "TCSUPPORT_PUREBRIDGE Support"
#	select TCSUPPORT_KERNELCONFIG_TC3162_PB
#	help
#	      TC3162 Pure Bridge support

config TCSUPPORT_KERNELCONFIG_AUTO
	bool "Kernel config auto Support"
	help
	      Kernel config auto Support

choice
	prompt "Kernel Config Selected"
	depends !TCSUPPORT_KERNELCONFIG_AUTO
	
config TCSUPPORT_KERNELCONFIG_TC3162
	depends TCSUPPORT_CPU_TC3162 && !TCSUPPORT_PUREBRIDGE
	bool "TCSUPPORT_KERNELCONFIG_TC3162 Support"
	help
	      TC3162 Kernel config support

config TCSUPPORT_KERNELCONFIG_TC3162_PB
	depends TCSUPPORT_CPU_TC3162 && TCSUPPORT_PUREBRIDGE
	bool "TCSUPPORT_KERNELCONFIG_TC3162_PB Support"
	help
	      TC3162 Pure Bridge Kernel config support

config TCSUPPORT_KERNELCONFIG_TC3162_VOIP
	depends TCSUPPORT_CPU_TC3162 && !TCSUPPORT_PUREBRIDGE
	bool "TCSUPPORT_KERNELCONFIG_TC3162_VOIP Support"
	help
	      TC3162 VOIP Kernel config support
	      
config TCSUPPORT_KERNELCONFIG_TC3162_IPv6
	depends TCSUPPORT_CPU_TC3162 && !TCSUPPORT_PUREBRIDGE
	bool "TCSUPPORT_KERNELCONFIG_TC3162_IPv6 Support"
	help
	      TC3162 IPv6 Kernel config support
	      
config TCSUPPORT_KERNELCONFIG_TC3162U
	depends TCSUPPORT_CPU_TC3162U
	bool "TCSUPPORT_KERNELCONFIG_TC3162U Support"
	help
	      TC3162U Kernel config support

config TCSUPPORT_KERNELCONFIG_TC3162U_IPv6
	depends TCSUPPORT_CPU_TC3162U || TCSUPPORT_CPU_RT63260
	bool "TCSUPPORT_KERNELCONFIG_TC3162U_IPv6 Support"
	help
	      TC3162U IPv6 Kernel config support
	      
config TCSUPPORT_KERNELCONFIG_TC3262
	depends TCSUPPORT_CPU_TC3262
	bool "TCSUPPORT_KERNELCONFIG_TC3262 Support"
	help
	      TC3262 Kernel config support	     	      	      	      	    	      


config TCSUPPORT_KERNELCONFIG_TC3182
	depends TCSUPPORT_CPU_TC3182
	bool "TCSUPPORT_KERNELCONFIG_TC3182 Support"
	help
	      TC3182 Kernel config support	
	      
config TCSUPPORT_KERNELCONFIG_RT63165
	depends TCSUPPORT_CPU_RT63165
	bool "TCSUPPORT_KERNELCONFIG_RT63165 Support"
	help
	      RT63165 Kernel config support	
	      
config TCSUPPORT_KERNELCONFIG_RT63365
	depends TCSUPPORT_CPU_RT63365  || TCSUPPORT_CPU_RT63368
	bool "TCSUPPORT_KERNELCONFIG_RT63365 Support"
	help
	      RT63365 Kernel config support	

config TCSUPPORT_KERNELCONFIG_RT65168
	depends TCSUPPORT_CPU_RT65168
	bool "TCSUPPORT_KERNELCONFIG_RT65168 Support"
	help
	      RT65168 Kernel config support	

endchoice

config TCSUPPORT_BUSYBOXCONFIG_AUTO
	bool "Busybox config auto Support"
	help
	      Busybox config auto Support

choice
	prompt "BusyBox Config Selected"
	depends !TCSUPPORT_BUSYBOXCONFIG_AUTO
	
config TCSUPPORT_BUSYBOXCONFIG_TC3162
	depends TCSUPPORT_CPU_TC3162 && !TCSUPPORT_PUREBRIDGE
	bool "TCSUPPORT_BUSYBOXCONFIG_TC3162 Support"
	help
	      TC3162 Busybox config support

config TCSUPPORT_BUSYBOXCONFIG_TC3162_PB
	depends TCSUPPORT_CPU_TC3162 && TCSUPPORT_PUREBRIDGE
	bool "TCSUPPORT_BUSYBOXCONFIG_TC3162_PB Support"
	help
	      TC3162 Pure Bridge Busybox config support
	      
config TCSUPPORT_BUSYBOXCONFIG_TC3162_IPv6
	depends TCSUPPORT_CPU_TC3162 && !TCSUPPORT_PUREBRIDGE
	bool "TCSUPPORT_BUSYBOXCONFIG_TC3162_IPv6 Support"
	help
	      TC3162 IPv6 Busybox config support
	      
config TCSUPPORT_BUSYBOXCONFIG_TC3162U
	depends TCSUPPORT_CPU_TC3162U
	bool "TCSUPPORT_BUSYBOXCONFIG_TC3162U Support"
	help
	      TC3162U Busybox config support

config TCSUPPORT_BUSYBOXCONFIG_TC3162U_IPv6
	depends TCSUPPORT_CPU_TC3162U || TCSUPPORT_CPU_RT63260
	bool "TCSUPPORT_BUSYBOXCONFIG_TC3162U_IPv6 Support"
	help
	      TC3162U IPv6 Busybox config support
	      
config TCSUPPORT_BUSYBOXCONFIG_TC3262
	depends TCSUPPORT_CPU_TC3262 || TCSUPPORT_CPU_TC3182 || TCSUPPORT_CPU_RT63165 || TCSUPPORT_CPU_RT63365  || TCSUPPORT_CPU_RT63368 || TCSUPPORT_CPU_RT65168
	bool "TCSUPPORT_BUSYBOXCONFIG_TC3262 Support"
	help
	      TC3262 & TC3182 & RT63165 & RT63365  & RT63368 & RT65168 Busybox config support   
	      
endchoice

menu "Driver Feature"

choice
	prompt "DMT Type Selected"
	default TCSUPPORT_DMT_3086
config TCSUPPORT_DMT_3085
	bool "TCSUPPORT_DMT_3085 Support"
	help
	      3085 DMT support

config TCSUPPORT_DMT_3086
	bool "TCSUPPORT_DMT_3086 Support"
	help
	      3086 DMT support
	      
config TCSUPPORT_DMT_3087
	bool "TCSUPPORT_DMT_3087 Support"
	help
	      3087 DMT support
	      
config TCSUPPORT_DMT_3095
	bool "TCSUPPORT_DMT_3095 Support"
	help
	      3095 DMT support
	      
endchoice
config TCSUPPORT_DUAL_IMAGE
	depends TCSUPPORT_CPU_TC3162U || TCSUPPORT_CPU_TC3182 || TCSUPPORT_CPU_RT63365  || TCSUPPORT_CPU_RT63368
	bool "Dual image support"
	help
	      Dual image support(flash must support 8m or larger)
config TCSUPPORT_DUAL_IMAGE_ENHANCE
	depends TCSUPPORT_DUAL_IMAGE
	bool "Dual image enhance support"
	help
	      Support main img and slave img auto backup function


config TCSUPPORT_TR68LED
	bool "TR68 LED support"
	help
	      TR68 LED support

config TCSUPPORT_LEDKEY
	bool 
	default y
	prompt "LED and KEY additional request" if !TCSUPPORT_RELEASED_CODE
	help
	      support additional led and key request

config TCSUPPORT_WLAN
	depends !TCSUPPORT_PUREBRIDGE && !TCSUPPORT_CPU_RT63260
	bool "TCSUPPORT_WLAN Support"
	help
	      WLAN support

config TCSUPPORT_WLAN_8021X
	depends TCSUPPORT_WLAN
	bool "TCSUPPORT_WLAN_8021X Support"
	help
		Support WLAN 801.1x

config TCSUPPORT_WLAN_8021X_EXT
	depends TCSUPPORT_WLAN_8021X
	bool "TCSUPPORT_WLAN_8021X_EXT Support"
	help
		Support WLAN 801.1x extension	

config TCSUPPORT_WLAN_8021X_EXT_SHOW_MAC
	depends TCSUPPORT_WLAN_8021X_EXT
	bool "TCSUPPORT_WLAN_8021X_EXT_SHOW_MAC Support"
	help
		Support WLAN 801.1x extension(show mac address in Log)	

config TCSUPPORT_WLAN_WPS
	depends TCSUPPORT_WLAN
	bool "TCSUPPORT_WLAN_WPS Support"
	help
	      WLAN WPS support	 

config TCSUPPORT_WLAN_WDS
	depends TCSUPPORT_WLAN
	bool "TCSUPPORT_WLAN_WDS Support"
	help
	      WLAN WDS support
		  
config TCSUPPORT_WLAN_IGMPSNOOP
	depends TCSUPPORT_WLAN
	bool "TCSUPPORT_WLAN_IGMPSNOOP Support"
	help
	      WLAN IGMP Snooping support

config TCSUPPORT_WLAN_ATE
	depends TCSUPPORT_WLAN
	bool "TCSUPPORT_WLAN_ATE Support"
	help
	      WLAN ATE tool support		 

config TCSUPPORT_WLAN_QATOOL
	depends TCSUPPORT_WLAN_ATE
	bool "TCSUPPORT_WLAN_QATOOL Support"
	help
	      WLAN QA tool support		 
	 
config TCSUPPORT_WLAN_WPS_LEDSPEC
	depends TCSUPPORT_WLAN_WPS
	bool "TCSUPPORT_WLAN_WPS_LEDSPEC Support"
	help
	      WLAN WPS LED Blink Spec support		     

config TCSUPPORT_WLAN_GPIO
	depends TCSUPPORT_WLAN && (TCSUPPORT_CPU_RT63365  || TCSUPPORT_CPU_RT63368)
	bool "TCSUPPORT_WLAN_GPIO Support"
	help
	      WLAN GPIO support		     

choice
	prompt "WiFi Chipset Selected"
	depends TCSUPPORT_WLAN
config TCSUPPORT_WLAN_RT2561
	depends TCSUPPORT_WLAN
	bool "TCSUPPORT_WLAN_RT2561 Support"
	help
	      RT2561 WiFi Driver support

config TCSUPPORT_WLAN_RT3390
	depends TCSUPPORT_WLAN
	bool "TCSUPPORT_WLAN_RT3390 Support"
	help
	      RT3390 WiFi Driver support

config TCSUPPORT_WLAN_RT3092
	depends TCSUPPORT_WLAN
	bool "TCSUPPORT_WLAN_RT3092 Support"
	help
	      RT3092 WiFi Driver support

config TCSUPPORT_WLAN_RT6856
	depends TCSUPPORT_WLAN
	bool "TCSUPPORT_WLAN_RT6856 Support"
	help
	      RT6856 iNIC WiFi Driver support
	      
config TCSUPPORT_WLAN_RT5392
	depends TCSUPPORT_WLAN
	bool "TCSUPPORT_WLAN_RT5392 Support"
	help
	      RT5392 WiFi Driver support

config TCSUPPORT_MTK_INTERNAL_ETHER_SWITCH
	depends TCSUPPORT_WLAN && TCSUPPORT_CPU_RT63365 &&(TCSUPPORT_WLAN_RT5392 || TCSUPPORT_WLAN_RT5390 ||TCSUPPORT_WLAN_RT5390HL)
	bool "TCSUPPORT_MTK_INTERNAL_ETHER_SWITCH Support"
	help
	      MTK INTERNAL ETHER SWITCH support

config TCSUPPORT_WLAN_RT5390
	depends TCSUPPORT_WLAN
	bool "TCSUPPORT_WLAN_RT5390 Support"
	help
	      RT5390 WiFi Driver support

config TCSUPPORT_MTK_INTERNAL_ETHER_SWITCH
	depends TCSUPPORT_WLAN && TCSUPPORT_CPU_RT63365 &&(TCSUPPORT_WLAN_RT5392 || TCSUPPORT_WLAN_RT5390 ||TCSUPPORT_WLAN_RT5390HL)
	bool "TCSUPPORT_MTK_INTERNAL_ETHER_SWITCH Support"
	help
	      MTK INTERNAL ETHER SWITCH support

config TCSUPPORT_WLAN_RT5390HL
	depends TCSUPPORT_WLAN
	bool "TCSUPPORT_WLAN_RT5390HL Support"
	help
	      RT5390HL WiFi Driver support

config TCSUPPORT_MTK_INTERNAL_ETHER_SWITCH
	depends TCSUPPORT_WLAN && TCSUPPORT_CPU_RT63365 &&(TCSUPPORT_WLAN_RT5392 || TCSUPPORT_WLAN_RT5390 ||TCSUPPORT_WLAN_RT5390HL)
	bool "TCSUPPORT_MTK_INTERNAL_ETHER_SWITCH Support"
	help
	      MTK INTERNAL ETHER SWITCH support

config TCSUPPORT_WLAN_RT3090
	depends TCSUPPORT_WLAN && !TCSUPPORT_RELEASED_CODE
	bool "TCSUPPORT_WLAN_RT3090 Support"
	help
	      RT3090 WiFi Driver support
	      	      
config TCSUPPORT_WLAN_MULTIDRIVER
	depends TCSUPPORT_WLAN
	bool "TCSUPPORT_WLAN_MULTIDRIVER Support"
	help
	      WiFi Multi Driver support(539x, 5592, 3593, 309x, 3390)
endchoice

choice
prompt "Dual band WiFi Chipset Selected"
depends TCSUPPORT_WLAN && TCSUPPORT_CPU_RT63368 && !TCSUPPORT_WLAN_MULTIDRIVER
config TCSUPPORT_NODUAL_BAND
	bool "No Support"
	help
		No senond wifi chip.

config TCSUPPORT_DUAL_WLAN_RT5592
    depends TCSUPPORT_WLAN && !TCSUPPORT_WLAN_RT5592
	bool "TCSUPPORT_WLAN_RT5592 Support"
	help
		RT5592 WiFi Driver support

config TCSUPPORT_DUAL_WLAN_RT3593
    depends TCSUPPORT_WLAN && !TCSUPPORT_WLAN_RT3593
        bool "TCSUPPORT_WLAN_RT3593 Support"
        help
                RT3593 WiFi Driver support

endchoice

choice
prompt "Dual band multi driver WiFi Chipset Selected"
depends TCSUPPORT_WLAN && TCSUPPORT_CPU_RT63368 && TCSUPPORT_WLAN_MULTIDRIVER
config TCSUPPORT_NODUAL_BAND
	bool "No Support"
	help
		No senond wifi chip.

config TCSUPPORT_DUAL_WLAN_RT5592_RT3593
    depends TCSUPPORT_WLAN
	bool "TCSUPPORT_WLAN_RT5592_RT3593 Support"
	help
		Dual Band WiFi Driver support
endchoice

menu "Virtual Private Network(VPN) Support"

config TCSUPPORT_VPN
	bool "TCSUPPORT_VPN Support"
	help
		use ipsec-tools to build a VPN client.

config TCSUPPORT_HW_CRYPTO
	bool "TCSUPPORT_HW_CRYPTO Support"
	help
		The crypto driver for HW Crypto Engine and the MTK_CRYPTO_DRIVER for Linux IPSec modification.

endmenu

config TCSUPPORT_USBHOST
	depends TCSUPPORT_CPU_TC3162U || TCSUPPORT_CPU_TC3262 || TCSUPPORT_CPU_TC3182 || TCSUPPORT_CPU_RT63165 || TCSUPPORT_CPU_RT63365  || TCSUPPORT_CPU_RT63368 || TCSUPPORT_CPU_RT65168
	bool "TCSUPPORT_USBHOST Support"
	help
	      USB Host 2.0 Driver support	
choice
prompt "NTFS solution Selected"
config TCSUPPORT_USB_NTFS
    depends TCSUPPORT_USBHOST
	bool "TCSUPPORT_USB_NTFS"
	help
		support ntfs filesystem in for usb mass storage
		use ntfs-3g
config TCSUPPORT_USB_NTFS_UFSD
    depends TCSUPPORT_USBHOST
	bool "TCSUPPORT_USB_NTFS_UFSD"
	help
		support ntfs filesystem in for usb mass storage
		use Paragon solution
endchoice

config TCSUPPORT_USB_AUTOMOUNT
	depends TCSUPPORT_USBHOST
	bool "TCSUPPORT_USB_AUTOMOUNT"
	help
		support auto-mount/umount feature for USB mass storage devices

config TCSUPPORT_USB_PRINTER_SERVER
    depends TCSUPPORT_USBHOST
	bool "TCSUPPORT_USB_PRINTER_SERVER"
	help
    	USB Printer Server support

config TCSUPPORT_USB_3G_DONGLE
	depends TCSUPPORT_USBHOST
	bool "TCSUPPORT_USB_3G_DONGLE"
	help
		USB 3G DONGLE support

config TCSUPPORT_USB_CAMERA
    depends TCSUPPORT_USBHOST
	bool "TCSUPPORT_USB_CAMERA"
	help
	     USB Camera support
	      
config TCSUPPORT_USBDEVICE11
	depends TCSUPPORT_CPU_TC3162 && !TCSUPPORT_RELEASED_CODE
	bool "TCSUPPORT_USBDEVICE11 Support"
	help
	      USB 1.1 Device Driver support	
	      
config TCSUPPORT_USBDEVICE20
	depends TCSUPPORT_CPU_TC3162U || TCSUPPORT_CPU_TC3262 || TCSUPPORT_CPU_TC3182 || TCSUPPORT_CPU_RT63260
	bool "TCSUPPORT_USBDEVICE20 Support"
	help
	      USB 2.0 Device Driver support	
	      
config TCSUPPORT_TC2031
	depends TCSUPPORT_CPU_TC3162U || TCSUPPORT_CPU_TC3162 || TCSUPPORT_CPU_RT63260
	bool "TCSUPPORT_TC2031 Support"
	help
	      TC2031 Single Port Switch support	
	      
	      
config TCSUPPORT_CMDAPI
	bool 
	default y
	prompt "TCSUPPORT_CMDAPI Support" if !TCSUPPORT_RELEASED_CODE
	help
	      Driver CMD API support	    

config TCSUPPORT_HWNAT
	depends TCSUPPORT_CPU_RT65168
	bool "TCSUPPORT_HWNAT Support"
	help
	      HWNAT support	

config TCSUPPORT_NAND_FLASH
	depends TCSUPPORT_CPU_RT63368
	bool "TCSUPPORT_NAND_FLASH Support"
	default n
	help
	     Nand Flash driver
choice
prompt "Checking nand badblock"
	depends TCSUPPORT_NAND_FLASH
config NOT_SUPPORT_BADBLOCK_CHECK
	bool "NOT_SUPPORT_BADBLOCK_CHECK"
	help
		Not Support Nand Badblock Check

config TCSUPPORT_NAND_BADBLOCK_CHECK
	bool "TCSUPPORT_NAND_BADBLOCK_CHECK support"
	help
		Nand Flash Badblock Check Support

config TCSUPPORT_NAND_RT63368
	bool "TCSUPPORT_NAND_RT63368 Support"
	help
		RT63368 Nand Flash Badblock Management Interface
endchoice

config TCSUPPORT_NAND_BMT
	bool "TCSUPPORT_NAND_BMT Support"
	depends TCSUPPORT_NAND_RT63368
	help
		Nand Flash Badblock Management Table

config TCSUPPORT_RA_HWNAT
	depends TCSUPPORT_CPU_RT63365  || TCSUPPORT_CPU_RT63368
	bool "TCSUPPORT_RA_HWNAT Support"
	help
	      RA HWNAT support	

endmenu

menu "Common Feature"
	depends !TCSUPPORT_PUREBRIDGE

menu "ASUS Feature"

choice
prompt "ASUS_APP"
config ASUS_APP_PREINSTALLED
	bool "pre-installed "
	help
		ASUS apps pre-installed in firmware
config	ASUS_APP_NETINSTALLED
	bool "install from internet"
	help
		ASUS apps download from internet
endchoice
config ASUS_WEBDAV
	bool "ASUS_WEBDAV"
	help
		AiCloud support
config ASUS_CLOUDSYNC
	bool "ASUS_CLOUDSYNC"
	help
		AiCloud sync
config ASUS_MEDIA_SERVER
	bool "ASUS_MEDIA_SERVER"
	help
		Media Server
config ASUS_SHP
	bool "ASUS_SHP"
	help
		short path
config ASUS_SWAP_FILE
	bool "ASUS_SWAP_FILE"
	help
		swap file in usb disk
config ASUS_ACCEL_PPTPD
	bool "ACCEL PPTP Server"
	help
		PPTP VPN Server

config ASUS_SPECTRUM
	bool "SPECTRUM FEATURE"
	help
		Shows SNR and bits per carrier information on GUI

config ASUS_DSL_POWER_SAVING
	bool "DSL Power Saving"
	default n
	help
		Close DSL if not used.

endmenu

config TCSUPPORT_IPV6
	bool "TCSUPPORT_IPV6 Support"
	help
	      IPv6 support
config TCSUPPORT_IPV6_ENHANCEMENT
	default y
	depends TCSUPPORT_IPV6
	bool "TCSUPPORT_IPV6_Enhancement"
	help
	      TC IPv6 enhancement ipv6 kernel

config TCSUPPORT_DSLITE
	default n
	depends TCSUPPORT_IPV6
	bool "TCSUPPORT_DSLITE"
	help
	      Dual Stack Lite feature

config TCSUPPORT_6RD
	depends TCSUPPORT_IPV6
	bool "TCSUPPORT_6RD"
	help 
		Support for RFC5969 IPv6 Rapid Deployment(6RD)

config TCSUPPORT_OPT212
	depends TCSUPPORT_6RD
	bool "TCSUPPORT_OPT212"
	help
		Support DHCP Option 212(6rd)

config TCSUPPORT_IPV6_ADVANCE
	default n
	depends TCSUPPORT_IPV6
	bool "TCSUPPORT_IPV6_ADVANCE"
	help
	      IPv6 advance feature,like firewall,acl,filter 

config TCSUPPORT_IPV6_FIREWALL
	default n
	depends TCSUPPORT_IPV6_ADVANCE
	bool "TCSUPPORT_IPV6_FIREWALL"
	help
	      IPv6 firewall feature 

config TCSUPPORT_IPV6_FIREWALL_RFC2827
	default n
	depends TCSUPPORT_IPV6_FIREWALL
	bool "TCSUPPORT_IPV6_FIREWALL_RFC2827"
	help
	      IPv6 firewall feature for rfc2827 

config TCSUPPORT_IPV6_RIPNG
	default n
	depends TCSUPPORT_IPV6
	depends !TCSUPPORT_RELEASED_CODE
	bool "TCSUPPORT_IPV6_RIPNG"
	help
	      IPv6 RIPng feature 
	      Note: Not support: TCSUPPORT_WAN_ETHER , TCSUPPORT_WAN_PTM, 
	      TCSUPPORT_C1_TRUE

config TCSUPPORT_IPV6_TELNET
	default n
	depends TCSUPPORT_IPV6
	bool "TCSUPPORT_IPV6_TELNET"
	help
	      IPv6 telnet feature 

config TCSUPPORT_IPV6_TFTP
	default n
	depends TCSUPPORT_IPV6
	bool "TCSUPPORT_IPV6_TFTP"
	help
	      IPv6 tftpd feature 

config	TCSUPPORT_IPV6_FTP
	default n
	depends TCSUPPORT_IPV6
	select TCSUPPORT_IPV6_INETD
	bool "TCSUPPORT_IPV6_FTP Support"
	help
		FTP support ipv6 

config	TCSUPPORT_IPV6_INETD
	default n
	depends TCSUPPORT_IPV6
	bool "TCSUPPORT_IPV6_INETD Support"
	help
		INETD support ipv6 
config	TCSUPPORT_IPV6_PRIVACYADDRS
	default n
	depends TCSUPPORT_IPV6
	bool "TCSUPPORT_IPV6_PRIVACYADDRS Support"
	help
		 support ipv6 privacy addresss


config TCSUPPORT_VOIP
	depends TCSUPPORT_CPU_TC3262 || TCSUPPORT_CPU_TC3182 || TCSUPPORT_CPU_RT63165 || TCSUPPORT_CPU_RT65168 || TCSUPPORT_CPU_RT63368
	select TCSUPPORT_QOS
	bool "TCSUPPORT_VOIP Support"
	help
	      VOIP Support
	
choice
	prompt "VOIP DSP SUPPORT"
	depends TCSUPPORT_VOIP
	
config TCSUPPORT_VOIP_WITH_DSP_AC
bool "TCSUPPORT_VOIP_WITH_DSP_AC Support"
	help
	   VOIP WITH AC support
	      
config TCSUPPORT_VOIP_WITH_DSP_D2
	bool "TCSUPPORT_VOIP_WITH_DSP_D2 Support"
	help
		VOIP WITH D2 support
config TCSUPPORT_VOIP_WITH_DSP_D2_2S1O
bool "TCSUPPORT_VOIP_WITH_DSP_D2 2S1O Support"
	help
		VOIP WITH D2 2S1O support

config TCSUPPORT_VOIP_WITH_DSP_D2_2S1O_SILAB
	bool "TCSUPPORT_VOIP_WITH_DSP_D2 2S1O Silicon Labs Support"
	help
		VOIP WITH D2 2S1O Silicon Labs support
		
config TCSUPPORT_VOIP_WITH_DSP_EVA_2S1O
	bool "TCSUPPORT_VOIP_WITH_DSP_EVA 2S1O Support"
	help
		VOIP WITH EVA 2S1O support
config TCSUPPORT_VOIP_WITH_DSP_EVA_1S_89156
	bool "TCSUPPORT_VOIP_WITH_DSP_EVA 1S 89156 Support"
	help
		VOIP WITH EVA 1S 89156 support

endchoice
	
config ASUSSUPPORT_EMAIL
bool "ASUSSUPPORT_EMAIL Support"
	help
	   Email support

config TCSUPPORT_CWMP
	bool "TCSUPPORT_CWMP Support"
	help
	      TR069 support
config TCSUPPORT_CWMP_CRPORTCHANGE
	depends TCSUPPORT_CWMP
	bool "TCSUPPORT_CWMP_CRPORTCHANGE Support"
	help
	      TR069 connection request port change support

config TCSUPPORT_CWMP_PRECISE_TIME
	depends TCSUPPORT_CWMP
	bool "TCSUPPORT_CWMP_PRECISE_TIME"
	help
	      TR069 download/upload with precise StartTime & CompleteTime

config TCSUPPORT_CWMP_CS_BSNL
	depends TCSUPPORT_CWMP && !TCSUPPORT_RELEASED_CODE
	bool "TCSUPPORT_CWMP_CS_BSNL"
	help
	      Support shrink TR69 parameters for BSNL  

config TCSUPPORT_RANDOM_INFORM
	depends TCSUPPORT_CWMP
	default y
	bool "TCSUPPORT_RANDOM_INFORM Support"
	help
		Support TR069 random inform

config TCSUPPORT_TRACEROUTE
	depends TCSUPPORT_CWMP && TCSUPPORT_SDRAM_32M
	bool "TCSUPPORT_TRACEROUTE Support(Make sure your busybox has opened the traceroute)"
	help
	      TC3162 IPv6 Kernel config support(Make sure your busybox has opened the traceroute)

config TCSUPPORT_CWMP_VDSL
	depends TCSUPPORT_CWMP && WAN_PTM
	bool "TCSUPPORT_CWMP_VDSL Support"
	help
	      Support VDSL PTM TR069 node

config TCSUPPORT_DOWNSTREAM_QOS
    bool "TCSUPPORT_DOWNSTREAM_QOS Support"
	help
		DOWNSTREAM QoS support
config TCSUPPORT_QOS
	bool "TCSUPPORT_QOS Support"
	help
		  QoS support
config TCSUPPORT_IGMP_QOS
	bool 
	default y
	prompt "TCSUPPORT_IGMP_QOS Support" if !TCSUPPORT_RELEASED_CODE
	depends TCSUPPORT_QOS 
	help
		 IGMP QoS support

config TCSUPPORT_QOS_QUEUE_MODIFY
	depends TCSUPPORT_QOS && !TCSUPPORT_RELEASED_CODE
	bool "TCSUPPORT_QOS_QUEUE_MODIFY Support"
	help
		support add/delete QoS Queue object

config TCSUPPORT_PORTBIND
	bool "TCSUPPORT_PORTBIND Support"
	help
		 Portbinding support

config TCSUPPORT_VLAN_TAG
	bool "TCSUPPORT_VLAN_TAG Support"
	help
		 vlan tag support
config TCSUPPORT_VTAG_ALLDEV
	depends TCSUPPORT_VLAN_TAG && !TCSUPPORT_MULTISERVICE_ON_WAN
	bool "TCSUPPORT_VTAG_ALLDEV Support"
	help
		 All devices vlan tag support
config TCSUPPORT_CWMP_SSL
	bool 
	default y
	prompt "TCSUPPORT_CWMP_SSL Support" if !TCSUPPORT_RELEASED_CODE
	depends TCSUPPORT_CWMP
	help
	      TR069 SSL Connection support

config TCSUPPORT_CWMP_SSL_MULTICA
	bool 
	default y 
	prompt "TCSUPPORT_CWMP_SSL MULTI CA Support" if !TCSUPPORT_RELEASED_CODE
	depends TCSUPPORT_CWMP_SSL
	help
	      TR069 SSL MULTI CA support

	      
config TCSUPPORT_CWMP_TR111
	bool 
	default y
	prompt "TCSUPPORT_CWMP_TR111 Support" if !TCSUPPORT_RELEASED_CODE
	depends on TCSUPPORT_CWMP
	help
	      TR069 TR111 support

config TCSUPPORT_CWMP_TR143
	bool 
	default y
	prompt "TCSUPPORT_CWMP_TR143 Support" if !TCSUPPORT_RELEASED_CODE
	depends TCSUPPORT_CWMP 
	help
	      TR069 TR143 support	

config TCSUPPORT_LAYER2BRIDGING
	depends TCSUPPORT_CWMP && TCSUPPORT_PORTBIND && !TCSUPPORT_RELEASED_CODE
	bool "TCSUPPORT_LAYER2BRIDGING SUPPORT"
	help
		Layer2bridging Support
config TCSUPPORT_WEBSERVER_SSL
	bool "TCSUPPORT_WEBSERVER_SSL Support"
	help
		Support Boa Web Server HTTPS
		
config TCSUPPORT_SSH
	bool "TCSUPPORT_SSH Support"
	help
		Support SSH

config TCSUPPORT_SNMP
	bool "TCSUPPORT_SNMP Support"
	help
	      SNMP support

choice
	prompt "SNMP Select"
	depends TCSUPPORT_SNMP

config TCSUPPORT_SNMP_FULL
	bool "TCSUPPORT_SNMP_FULL Support"
	help
	      Full SNMP support
		  
config TCSUPPORT_START_TRAP
	depends TCSUPPORT_SNMP_FULL
	bool "TCSUPPORT_START_TRAP Support"
	help
	      support start trap.

config TCSUPPORT_SNMP_V3
	depends TCSUPPORT_SNMP_FULL
	bool "TCSUPPORT_SNMP_V3 Support"
	help
	      support snmpv3.     

config TCSUPPORT_IPV6_SNMP
	depends TCSUPPORT_SNMP_FULL && TCSUPPORT_IPV6
	bool "TCSUPPORT_IPV6_SNMP Support"
	help
	      Support SNMP IPv6	

config TCSUPPORT_SNMP_REDUCED
	bool "TCSUPPORT_SNMP_REDUCED Support"
	help
	      Reduced SNMP support
	      	      
endchoice

config TCSUPPORT_SNMP_TRUSTIP
	depends TCSUPPORT_SNMP
	bool "TCSUPPORT_SNMP_TRUSTIP"
	help
		SNMP trust ip rang support
config TCSUPPORT_SNMP_ATMADSL
	depends TCSUPPORT_SNMP
	bool "TCSUPPORT_SNMP_ATMADSL Support"
	help
	      SNMP ATM & ADSL MIB Node
	      
config TCSUPPORT_ALIASIP
	bool "TCSUPPORT_ALIASIP Support"
	help
	      Alias IP support
	      
config TCSUPPORT_DHCP_STATIC
	bool "TCSUPPORT_DHCP_STATIC Support"
	help
	      Static DHCP Pool support
	      
config TCSUPPORT_DHCP_PROFILE
	bool "TCSUPPORT_DHCP_PROFILE Support"
	help
	      DHCP Option60 & 240 support

config TCSUPPORT_E8B
	bool "TCSUPPORT_E8B Support"
	help
	      Telecom E8B customer feature

config TCSUPPORT_DNSEACHPVC
	bool "TCSUPPORT_DNSEACHPVC Support"
	help
	      DNS for Each PVC support
if TCSUPPORT_IPV6
config TCSUPPORT_MLD_SNOOPING
	bool "TCSUPPORT_MLD_SNOOPING Support"
	help
	      Support MLD snooping for IPv6

config TCSUPPORT_MLD_PROXY
	bool "TCSUPPORT_MLD_PROXY Support"
	help
	      Support MLD proxy for IPv6

endif
config TCSUPPORT_IGMP_PROXY_V3
	bool "TCSUPPORT_IGMP_PROXY_V3 Support"
	help
	      igmp proxy function support,igmp v1/2/3	

config TCSUPPORT_IGMP_SNOOPING
	bool "TCSUPPORT_IGMP_SNOOPING Support"
	help
	      igmp snooping function support	

config TCSUPPORT_IGMP_SNOOPING_V3
	bool 
	default y
	prompt "IGMP_SNOOPING_V3 Support" if !TCSUPPORT_RELEASED_CODE
	depends TCSUPPORT_IGMP_SNOOPING
	help
	      igmp snooping v3 function support
		  
config TCSUPPORT_SMUX
	depends TCSUPPORT_CPU_RT63365  || TCSUPPORT_CPU_RT63368 ||TCSUPPORT_CPU_RT65168
	bool "TCSUPPORT_SMUX Support"
	help
	      Multi interfaces for Each PVC support	

config TCSUPPORT_MTD_ENCHANCEMENT
	bool "TCSUPPORT_MTD_ENCHANCEMENT Support"
	help
	      mtd enchancement function support	

config TCSUPPORT_RESERVEAREA_BLOCK
	int "TCSUPPORT_RESERVEAREA_BLOCK Support"
	default "4"
	depends on TCSUPPORT_MTD_ENCHANCEMENT
	help
	  	 block num of which reserve area cover
		 note:
		 	default value is 4.you must know what you do when you 
			modify this value,the value is only support to set 1,2,3 or 4.
  
config TCSUPPORT_BACKUPROMFILE
	bool "TCSUPPORT_BACKUPROMFILE Support"
	depends on TCSUPPORT_MTD_ENCHANCEMENT
	help
	      support backup romfile function

config TCSUPPORT_NOTDEFAULTROMFILEAREA
	bool "TCSUPPORT_NOTDEFAULTROMFILEAREA Support"
	depends on TCSUPPORT_BACKUPROMFILE
	help
	     not support default romfile function

config TCSUPPORT_CT_2PWIFI
	bool "TCSUPPORT_CT_2PWIFI Support"
	help
	      2PWIFI customer feature
config TCSUPPORT_PRODUCTIONLINE
	depends on TCSUPPORT_MTD_ENCHANCEMENT
	bool "TCSUPPORT_PRODUCTIONLINE Support"
	help 
		 production line test  

config TCSUPPORT_UNIQUEMAC
	# depends !TCSUPPORT_RELEASED_CODE
	# remove dependency for share pvc, Sam 2013/5/29
	bool "TCSUPPORT_UNIQUEMAC Support"
	help
		auto config unique MAC for PVC

config TCSUPPORT_SHARE_PVC
	depends TCSUPPORT_UNIQUEMAC
	bool "TCSUPPORT_SHARE_PVC Support"
	help
		Multiple session share one PVC

config TCSUPPORT_UNIQUEMAC_ALL
	depends TCSUPPORT_UNIQUEMAC
	bool "TCSUPPORT_UNIQUEMAC_ALL Support"
	help
		auto config unique MAC for WAN LAN WIFI

config TCSUPPORT_SYSLOG
	bool "TCSUPPORT_SYSLOG Support"
	help
		new syslog mechanism
config TCSUPPORT_SYSLOG_ENHANCE
	depends TCSUPPORT_SYSLOG
	bool "TCSUPPORT_SYSLOG_ENHANCE"
	help
	      Support syslog feature
		  (1) save to flash;
		  (2) log by log level.
config TCSUPPORT_REMOTE_SYSLOG
	depends TCSUPPORT_SYSLOG
	bool "TCSUPPORT_REMOTE_SYSLOG"
	help
	      Support remote server syslog


config TCSUPPORT_AUTO_IP
	bool "TCSUPPORT_AUTO_IP Support"
	default n
	help
	      Lan auto ip feature for DLNA test

config TCSUPPORT_DMS
	bool "TCSUPPORT_DMS Support"
	default n
	help
	      DLNA DMS feature

config TCSUPPORT_DMS_FULL_FORMAT
	depends on TCSUPPORT_DMS
	bool "TCSUPPORT_DMS_FULL_FORMAT Support"
	default y
	help
	      DMS will support more media format more than LPCM/JPEG_SM/MPEG_PS_NTSC

config TCSUPPORT_WEB_SAVE
	bool 
	default y
	prompt "TCSUPPORT_WEB_SAVE Support" if !TCSUPPORT_RELEASED_CODE
	help
	      setting will be save in flash if do save in web page

config TCSUPPORT_FW_UPGRADE_16M
	bool
	default y
	prompt "TCSUPPORT_FW_UPGRADE_16M Support" if !TCSUPPORT_RELEASED_CODE
	help
		upgrade 16M firmware

config TCSUPPORT_BRIDGE_FASTPATH
    bool "TCSUPPORT_BRIDGE_FASTPATH Support"
	help
		Support fastpath in bridge mode
				
config RA_PARENTALCONTROL
	bool "RA_PARENTALCONTROL Support"
	default n
	help
		Parental Control feature
config TCSUPPORT_PARENTAL_URLBLOCK
	depends RA_PARENTALCONTROL
	bool "TCSUPPORT_PARENTAL_URLBLOCK Support"
	help
	      support Parental URL block	
		
config TCSUPPORT_AUTO_DEFAULT_ROUTER
	depends !TCSUPPORT_RELEASED_CODE
	bool "TCSUPPORT_AUTO_DEFAULT_ROUTER Support"
	default n
	help
		support Auto default route

config TCSUPPORT_AUTO_WIFI_SSID
	depends on TCSUPPORT_AUTO_DEFAULT_ROUTER  && !TCSUPPORT_RELEASED_CODE
	bool "TCSUPPORT_AUTO_WIFI_SSID Support"
	help
		  Support Auto wifi SSID
		  
config TCSUPPORT_RA_MENU
	depends !TCSUPPORT_RELEASED_CODE
	bool "TCSUPPORT_RA_MENU Support"
	default n
	help
		Support the command menu list to configure the cpe settings

config TCSUPPORT_SIPROXD
	depends !TCSUPPORT_CPU_TC3182 && !TCSUPPORT_CPU_RT63260
	bool "TCSUPPORT_SIPROXD Support"
	default n
	help
		Siproxd support
config TCSUPPORT_SAMBA
	bool "TCSUPPORT_SAMBA Support"
	default n
	help
		Samba Server support
		When you select this item, please change kernel_config:
		DOS/FAT/NT Filesystem [Default codepage for FAT:437->936]
							  [Default iocharset for FAT:ascii->utf8]
		Native Language Support [Default NLS Option:iso8859-1->utf8]
								[Codepage 437 not set]
								[Simplified Chinese charset(CP936,GB2312) set]
								[ASCII (United States) not set]
								[NLS UTF-8 set]
config TCSUPPORT_CODE_SHRINK
	depends TCSUPPORT_CPU_TC3162U || TCSUPPORT_CPU_RT63260
	bool "TCSUPPORT_CODE_SHRINK Support"
	default n
	help
		Web Page Code Shrink

config TCSUPPORT_MNT_CONF
	depends on TCSUPPORT_USB_AUTOMOUNT && TCSUPPORT_CPU_TC3162U
	bool "TCSUPPORT_MNT_CONF Support"
	default n
	help
		USB Auto Mount with mnt.conf
		
config RA_ETHERMEDIATYPE
	bool "RA_ETHERMEDIATYPE Support"
	default n
	help
		Ethernet Media Type Control feature
config TCSUPPORT_MODEL_CHECK
	bool "TCSUPPORT_MODEL_CHECK Support"
	help
	      ModelCheck feature

config TCSUPPORT_PORT_TRIGGER
	bool "TCSUPPORT_PORT_TRIGGER Support"
	help
		Support netfilter & iptables module: port trigger

config TCSUPPORT_RA_GUI
	bool "TCSUPPORT_RA_GUI Support"
	default n
	help
		Use compile option to display web page in RA GUI

config TCSUPPORT_FILTER_DSCP
	bool "TCSUPPORT_FILTER_DSCP Support"
	help
	      Support dscp filter.
config TCSUPPORT_2PORTS
	depends !TCSUPPORT_RELEASED_CODE
	bool "TCSUPPORT_2PORTS Support"
	help
	      Support 2 ports CPE.

config TCSUPPORT_DHCP_PORT_FLT
	bool "TCSUPPORT_DHCP_PORT_FLT"
	help
	      Support lan dhcp port filter.
choice
	prompt "Multiple NTP Server"
config TCSUPPORT_1NTP_SERVER
	bool "TCSUPPORT_1NTP_SERVER"
	help
		Support only one ntp server(default)
config TCSUPPORT_2NTP_SERVER
	bool "TCSUPPORT_2NTP_SERVER"
	help
	      Support 2 ntp servers.
config TCSUPPORT_3NTP_SERVER
	bool "TCSUPPORT_3NTP_SERVER"
	help
	      Support 3 ntp servers.
endchoice
config TCSUPPORT_UPNP_CERT
	bool
	default y
	prompt "TCSUPPORT_UPNP_CERT" if !TCSUPPORT_RELEASED_CODE
	help
	      Support Upnp Certification Test.
config TCSUPPORT_PPP_AUTHEN
	bool "TCSUPPORT_PPP_AUTHEN"
	help
	      Support pap && chap authen in ppp mode.
config TCSUPPORT_TFTP_UPGRADE_PROTECT
	bool "TCSUPPORT_TFTP_UPGRADE_PROTECT Support"
	help
		Support tftp upgrade protection
		If support IPv6, must enable TCSUPPORT_IPV6_TELNET and TCSUPPORT_IPV6_TFTP

config TCSUPPORT_TR069_OPT43
	bool "TCSUPPORT_TR069_OPT43"
	help
	      Support DHCP Option 43 for TR069.

config TCSUPPORT_GENERAL_MULTILANGUAGE
	bool "TCSUPPORT_GENERAL_MULTILANGUAGE"
	help
		Support multi language on gui
		
config TCSUPPORT_FWNAME_NOCHK 
	depends !TCSUPPORT_RELEASED_CODE
	bool "TCSUPPORT_FWNAME_NOCHK"
	help 
		Remove firmware name check in upgrade web page.
config TCSUPPORT_MODEL_NAME_CUSKIT
	bool "TCSUPPORT_MODEL_NAME_CUSKIT Support"
	default n
	help
		Support model name cuskit

config TCSUPPORT_MEMORY_CONTROL
	bool "TCSUPPORT_MEMORY_CONTROL Support"
	help
		Support memory control
config TCSUPPORT_ETH4_WAN_PORT
	depends !TCSUPPORT_CPU_RT63365  && !TCSUPPORT_CPU_RT63368
	bool "TCSUPPORT_ETH4_WAN_PORT Support"
	help
		ether port 4 as wan port

config TCSUPPORT_FTP_THROUGHPUT
	depends on TCSUPPORT_CPU_TC3162 || TCSUPPORT_CPU_RT63260
	bool "TCSUPPORT_FTP_THROUGHPUT Support"
	help
		Support TC3162 CPU ftp throughput
		
config	TCSUPPORT_SBTHROUGHPUT_ENHANCE	
	bool "TCSUPPORT_SBTHROUGHPUT_ENHANCE Support"
	help
		Enlarge Smartbit throughput of routing mode
		
config	TCSUPPORT_VPN_SWITCH_GUI	
	bool "TCSUPPORT_VPN_SWITCH_GUI Support"
	help
		Add VPN Switch on adv_nat_top webpage for TC2 general.

config	TCSUPPORT_LAYER3FORWARD_ENHANCEMENT	
	bool "TCSUPPORT_LAYER3FORWARD_ENHANCEMENT Support"
	help
		TR69 Layer3forwarding will support Enable and SourceIP
		
config	TCSUPPORT_UPGRADE_WDOGREBOOT	
	bool "TCSUPPORT_UPGRADE_WDOGREBOOT Support"
	help
		Upgrade firmware need watch dog reboot

config TCSUPPORT_LED_BTN_CHECK
	bool "TCSUPPORT_LED_BTN_CHECK Support"
	default n
	help
	      support LED BTN CHECK

config TCSUPPORT_LED_CHECK
	default n
	depends TCSUPPORT_LED_BTN_CHECK
	bool "TCSUPPORT_LED_CHECK Support"
	help
	      support LED CHECK

config TCSUPPORT_BTN_CHECK
	default n
	depends TCSUPPORT_LED_BTN_CHECK
	bool "TCSUPPORT_BTN_CHECK Support"
	help
	      support BTN CHECK 

config	TCSUPPORT_RESTORE_LINOS_INFO
	depends TCSUPPORT_CPU_TC3162U || TCSUPPORT_CPU_RT63260
	bool "TCSUPPORT_RESTORE_LINOS_INFO Support"
	help
		Will support restore linos MRD info into linux when upgrage from linos to linux. 
		Be sure that linos has the function of upgrade linux.

config	TCSUPPORT_WPA_SUPPLICANT	
	bool "TCSUPPORT_WPA_SUPPLICANT Support"
	help
		WPA SUPPLICANT support/802.1X for IPoE

config	TCSUPPORT_SUPPORT_FLASH
	bool "TCSUPPORT_SUPPORT_FLASH Support"
	help
		Add a webpage to show version ,build date and supporting flash.  

config	TCSUPPORT_TEST_LED_ALL
	bool "TCSUPPORT_TEST_LED_ALL Support"
	help
		Add a CI command to let all led on or off. 

config TCSUPPORT_RESTORE_ROM_T
	depends TCSUPPORT_CPU_TC3162U || TCSUPPORT_CPU_RT63260
	bool "TCSUPPORT_RESTORE_ROM_T"
	help
		Support retore LiNOS key parameters to linux romfile when upgrade from LiNOS to linux.	

config TCSUPPORT_WLAN_MAXSTANUM_GUI
	depends TCSUPPORT_WLAN
	bool "TCSUPPORT_WLAN_MAXSTANUM_GUI"
	help
		Add Max station number on WLan webpage for TC2 general.

config	TCSUPPORT_MULTISERVICE_ON_WAN
	depends TCSUPPORT_CPU_RT63365  || TCSUPPORT_CPU_RT63368 || TCSUPPORT_CPU_RT65168
	depends on WAN_PTM || WAN_ETHER
	bool "TCSUPPORT_MULTISERVICE_ON_WAN Support"
	help
		support MultiService on Wan interface. 
config TCSUPPORT_AGEOUT_MAC
	bool "TCSUPPORT_AGEOUT_MAC"
	help
		support when IVL MAC enable, lan 2 lan can not communicate in some case

menu "Ethernet Port Mapping to Switch Port"
	depends TCSUPPORT_CPU_RT63368 || TCSUPPORT_CPU_RT63365

config TCSUPPORT_MANUAL_ETHERNET_PORTMAP
	depends TCSUPPORT_CPU_RT63368 || TCSUPPORT_CPU_RT63365
	bool "TCSUPPORT_MANUAL_ETHERNET_PORTMAP Support"
	help
	      Manual Ethernet Port Mapping support
	
config TCSUPPORT_WAN_PORT
	int "TCSUPPORT_WAN_PORT"
	default "-1"
	depends on TCSUPPORT_MANUAL_ETHERNET_PORTMAP
	help
	  	 the switch port number which wan port map to
	
config TCSUPPORT_LAN0_PORT
	int "TCSUPPORT_LAN0_PORT"
	default "-1"
	depends on TCSUPPORT_MANUAL_ETHERNET_PORTMAP
	help
	  	 the switch port number which lan0 port map to
  
config TCSUPPORT_LAN1_PORT
	int "TCSUPPORT_LAN1_PORT"
	default "-1"
	depends on TCSUPPORT_MANUAL_ETHERNET_PORTMAP
	help
	  	 the switch port number which lan1 port map to

config TCSUPPORT_LAN2_PORT
	int "TCSUPPORT_LAN2_PORT"
	default "-1"
	depends on TCSUPPORT_MANUAL_ETHERNET_PORTMAP
	help
	  	 the switch port number which lan2 port map to
  
config TCSUPPORT_LAN3_PORT
	int "TCSUPPORT_LAN3_PORT"
	default "-1"
	depends on TCSUPPORT_MANUAL_ETHERNET_PORTMAP
	help
	  	 the switch port number which lan3 port map to

config TCSUPPORT_LAN4_PORT
	int "TCSUPPORT_LAN4_PORT"
	default "-1"
	depends on TCSUPPORT_MANUAL_ETHERNET_PORTMAP
	help
	  	 the switch port number which lan4 port map to
  
config TCSUPPORT_LAN5_PORT
	int "TCSUPPORT_LAN5_PORT"
	default "-1"
	depends on TCSUPPORT_MANUAL_ETHERNET_PORTMAP
	help
	  	 the switch port number which lan5 port map to

endmenu	
endmenu	
	      	      	      	     	      	      	     
source "CustomConfig" 
      	      	     	      	      	     
choice
	  prompt "Release Type"
config TCSUPPORT_RELEASED_CODE
    bool "TCSUPPORT_RELEASED_CODE RT"
    help
         The flag of code release
endchoice
```
